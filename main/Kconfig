## main/Kconfig
```kconfig
menu "roberto"

    config ROBERTO_WIFI_SSID
        string "ssid"
        help
            the wifi network to be used by the smartscreen

    config ROBERTO_WIFI_PASSWORD
        string "wifi password"
        help
            the wifi password to be used by the smartscreen

    config ROBERTO_DISPLAY_CLOCK_PIN
        int "display clock pin"
        default 18
        help
            SPI clock pin for the display controller

    config ROBERTO_DISPLAY_DATA_PIN
        int "display data pin"
        default 23
        help
            SPI data pin (SDA) for the display controller

    config ROBERTO_DISPLAY_READ_DATA_PIN
        int "display read data pin"
        default 23
        help
            SPI read data pin (SDO) for the display controller

    config ROBERTO_DISPLAY_DEVICE_SELECT_PIN
        int "display device select pin"
        default 15
        help
            SPI device select (CS) pin for the display controller

    config ROBERTO_DISPLAY_COMMAND_PIN
        int "display command pin"
        default 2
        help
            command pin (RS) for the display controller

    config ROBERTO_DISPLAY_RESET_PIN
        int "display reset pin"
        default 4
        help
            reset pin (RST) for the display controller

    config ROBERTO_ID
        string "device id"
        default "smartscreen-1"
        help
            the id of this smartscren

    config ROBERTO_HOME_ADDRESS
        string "home address"
        help
            the address of this smartscreen's home backend

    config ROBERTO_NAME
        string "host name"
        default "smartscreen"
        help
            the mDNS name of this device

    config ROBERTO_AP_PASSWORD
        string "access point password"
        default "roberto123"
        help
            roberto access point password for direct mode

    config ROBERTO_WAIT_FOR_DEBUGGER
        bool "wait for debugger"
        default false
        help
            put a wait loop at the beginning of the main function for debuggers
endmenu
```
